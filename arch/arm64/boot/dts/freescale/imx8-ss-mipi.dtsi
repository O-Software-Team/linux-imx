// SPDX-License-Identifier: GPL-2.0+
/*
 * Copyright 2019-2020 NXP
 *	Dong Aisheng <aisheng.dong@nxp.com>
 */

mipi_subsys: bus@5c000000 {
	compatible = "simple-bus";
	#address-cells = <1>;
	#size-cells = <1>;
	ranges = <0x5c000000 0x0 0x5c000000 0x1000000>;

	ddr_pmu0: ddr-pmu@5c020000 {
		compatible = "fsl,imx8qxp-mipi-pmu", "fsl,imx8-mipi-pmu";
		reg = <0x5c020000 0x10000>;
		interrupts = <GIC_SPI 131 IRQ_TYPE_LEVEL_HIGH>;
	};
};
